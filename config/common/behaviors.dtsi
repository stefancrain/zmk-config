td0: tap_dance_0 {
    compatible = "zmk,behavior-tap-dance";
    label = "TAP_DANCE_0";
    #binding-cells = <0>;
    tapping-term-ms = <200>;
    bindings =
        <&kp N1>,
        <&kp N2>,
        <&kp N3>;
};
td_mt: tap_dance_mod_tap {
    compatible = "zmk,behavior-tap-dance";
    label = "TAP_DANCE_MOD_TAP";
    #binding-cells = <0>;
    tapping-term-ms = <200>;
    bindings =
        <&mt LSHIFT CAPSLOCK>,
        <&kp LCTRL>;
};
